## drivers/misc/mediatek/lens/Kconfig
```kconfig
config MTK_LENS
  bool CONFIG_MTK_LENS
  default n
  help
    CONFIG_MTK_LENS

config MTK_LENS_USE_MODULE
  bool "Mediatek lens driver build as module"
  default n
  help
    Say Y here if you want to build touch driver as xxx.ko.

    If unsure, say N.

    To compile this dirver as a module,
    It will be called by insmod xxx.ko in init.rc.

#
# LENS
#

config MTK_LENS_DUMMYLENS_SUPPORT
  bool "Dummy Lens Driver"
  default n
  help
    Dummy Lens Driver
    This config is used to enable the corresponding
    lens driver for the camera sensor module
    Set as y if the driver is used in this project

config MTK_LENS_BU63165AF_SUPPORT
  bool "BU63165AF Lens Driver"
  default n
  help
    BU63165AF Lens Driver
    This config is used to enable the corresponding
    lens driver for the camera sensor module
    Set as y if the driver is used in this project

config MTK_LENS_AD5820AF_SUPPORT
  bool "AD5820AF Lens Driver"
  default n
  help
    AD5820AF Lens Driver
    This config is used to enable the corresponding
    lens driver for the camera sensor module
    Set as y if the driver is used in this project

config MTK_LENS_AD5823_SUPPORT
  bool "AD5823 Lens Driver"
  default n
  help
    AD5823 Lens Driver
    This config is used to enable the corresponding
    lens driver for the camera sensor module
    Set as y if the driver is used in this project

config MTK_LENS_AD5823AF_SUPPORT
  bool "AD5823AF Lens Driver"
  default n
  help
    AD5823AF Lens Driver
    This config is used to enable the corresponding
    lens driver for the camera sensor module
    Set as y if the driver is used in this project

config MTK_LENS_AK7345AF_SUPPORT
  bool "AK7345AF Lens Driver"
  default n
  help
    AK7345AF Lens Driver
    This config is used to enable the corresponding
    lens driver for the camera sensor module
    Set as y if the driver is used in this project

config MTK_LENS_AK7371AF_SUPPORT
  bool "AK7371AF Lens Driver"
  default n
  help
    AK7371AF Lens Driver
    This config is used to enable the corresponding
    lens driver for the camera sensor module
    Set as y if the driver is used in this project

config MTK_LENS_BU6424AF_SUPPORT
  bool "BU6424AF Lens Driver"
  default n
  help
    BU6424AF Lens Driver
    This config is used to enable the corresponding
    lens driver for the camera sensor module
    Set as y if the driver is used in this project

config MTK_LENS_BU6429AF_SUPPORT
  bool "BU6429AF Lens Driver"
  default n
  help
    BU6429AF Lens Driver
    This config is used to enable the corresponding
    lens driver for the camera sensor module
    Set as y if the driver is used in this project

config MTK_LENS_BU64745GWZAF_SUPPORT
  bool "BU64745GWZAF Lens Driver"
  default n
  help
    BU64745GWZAF Lens Driver
    This config is used to enable the corresponding
    lens driver for the camera sensor module
    Set as y if the driver is used in this project

config MTK_LENS_AK7345AF_SUPPORT
  bool "AK7345AF Lens Driver"
  default n
  help
    AK7345AF Lens Driver
    This config is used to enable the corresponding
    lens driver for the camera sensor module
    Set as y if the driver is used in this project

config MTK_LENS_DW9719TAF_SUPPORT
  bool "DW9719TAF Lens Driver"
  default n
  help
    DW9719TAF Lens Driver
    This config is used to enable the corresponding
    lens driver for the camera sensor module
    Set as y if the driver is used in this project

config MTK_LENS_DW9718AF_SUPPORT
  bool "DW9718AF Lens Driver"
  default n
  help
    DW9718AF Lens Driver
    This config is used to enable the corresponding
    lens driver for the camera sensor module
    Set as y if the driver is used in this project

config MTK_LENS_DW9714AF_SUPPORT
  bool "DW9714AF Lens Driver"
  default n
  help
    DW9714AF Lens Driver
    This config is used to enable the corresponding
    lens driver for the camera sensor module
    Set as y if the driver is used in this project

config MTK_LENS_DW9714A_SUPPORT
  bool "DW9714A Lens Driver"
  default n
  help
    DW9714A Lens Driver
    This config is used to enable the corresponding
    lens driver for the camera sensor module
    Set as y if the driver is used in this project

config MTK_LENS_DW9763AF_SUPPORT
  bool "DW9763AF Lens Driver"
  default n
  help
    DW9763AF Lens Driver
    This config is used to enable the corresponding
    lens driver for the camera sensor module
    Set as y if the driver is used in this project

config MTK_LENS_DW9814AF_SUPPORT
  bool "DW9814AF Lens Driver"
  default n
  help
    DW9814AF Lens Driver
    This config is used to enable the corresponding
    lens driver for the camera sensor module
    Set as y if the driver is used in this project

config MTK_LENS_LC898122AF_SUPPORT
  bool "LC898122AF Lens Driver"
  default n
  help
    LC898122AF Lens Driver
    This config is used to enable the corresponding
    lens driver for the camera sensor module
    Set as y if the driver is used in this project

config MTK_LENS_LC898212AF_SUPPORT
  bool "LC898212AF Lens Driver"
  default n
  help
    LC898212AF Lens Driver
    This config is used to enable the corresponding
    lens driver for the camera sensor module
    Set as y if the driver is used in this project

config MTK_LENS_LC898212XDAF_SUPPORT
  bool "LC898212XDAF Lens Driver"
  default n
  help
    LC898212XDAF Lens Driver
    This config is used to enable the corresponding
    lens driver for the camera sensor module
    Set as y if the driver is used in this project

config MTK_LENS_LC898214AF_SUPPORT
  bool "LC898214AF Lens Driver"
  default n
  help
    LC898212AF Lens Driver
    This config is used to enable the corresponding
    lens driver for the camera sensor module
    Set as y if the driver is used in this project

config MTK_LENS_GC8024AF_SUPPORT
  bool "GC8024AF Lens Driver"
  default n
  help
    GC8024AF Lens Driver
    This config is used to enable the corresponding
    lens driver for the camera sensor module
    Set as y if the driver is used in this project

config MTK_LENS_GC5005AF_SUPPORT
  bool "GC5005AF Lens Driver"
  default n
  help
    GC5005AF Lens Driver
    This config is used to enable the corresponding
    lens driver for the camera sensor module
    Set as y if the driver is used in this project

config MTK_LENS_GC5024AF_SUPPORT
  bool "GC5024AF Lens Driver"
  default n
  help
    GC5024AF Lens Driver
    This config is used to enable the corresponding
    lens driver for the camera sensor module
    Set as y if the driver is used in this project

config MTK_LENS_HM5040AF_SUPPORT
  bool "HM5040AF Lens Driver"
  default n
  help
    HM5040AF Lens Driver
    This config is used to enable the corresponding
    lens driver for the camera sensor module
    Set as y if the driver is used in this project

config MTK_LENS_IMX179AF_SUPPORT
  bool "IMX179AF Lens Driver"
  default n
  help
    IMX179AF Lens Driver
    This config is used to enable the corresponding
    lens driver for the camera sensor module
    Set as y if the driver is used in this project

config MTK_LENS_S5K3H7AF_SUPPORT
  bool "S5K3H7AF Lens Driver"
  default n
  help
    S5K3H7AF Lens Driver
    This config is used to enable the corresponding
    lens driver for the camera sensor module
    Set as y if the driver is used in this project

config MTK_LENS_S5K3H7YXAF_SUPPORT
  bool "S5K3H7YXAF Lens Driver"
  default n
  help
    S5K3H7YXAF Lens Driver
    This config is used to enable the corresponding
    lens driver for the camera sensor module
    Set as y if the driver is used in this project

config MTK_LENS_OV8865AF_SUPPORT
  bool "OV8865AF Lens Driver"
  default n
  help
    OV8865AF Lens Driver
    This config is used to enable the corresponding
    lens driver for the camera sensor module
    Set as y if the driver is used in this project

config MTK_LENS_FM50AF_SUPPORT
  bool "FM50AF Lens Driver"
  default n
  help
    FM50AF Lens Driver
    This config is used to enable the corresponding
    lens driver for the camera sensor module
    Set as y if the driver is used in this project

config MTK_LENS_MT9P017AF_SUPPORT
  bool "MT9P017AF Lens Driver"
  default n
  help
    MT9P017AF Lens Driver
    This config is used to enable the corresponding
    lens driver for the camera sensor module
    Set as y if the driver is used in this project

config MTK_LENS_OV8825AF_SUPPORT
  bool "OV8825AF Lens Driver"
  default n
  help
    OV8825AF Lens Driver
    This config is used to enable the corresponding
    lens driver for the camera sensor module
    Set as y if the driver is used in this project

config MTK_LENS_SENSORDRIVE_SUPPORT
  bool "SENSORDRIVE Lens Driver"
  default n
  help
    SENSORDRIVE Lens Driver
    This config is used to enable the corresponding
    lens driver for the camera sensor module
    Set as y if the driver is used in this project

config MTK_LENS_GAF001AF_SUPPORT
  bool "GAF001AF Lens Driver"
  default n
  help
    GAF001AF Lens Driver
    This config is used to enable the corresponding
    lens driver for the camera sensor module
    Set as y if the driver is used in this project

config MTK_LENS_GAF002AF_SUPPORT
  bool "GAF002AF Lens Driver"
  default n
  help
    GAF002AF Lens Driver
    This config is used to enable the corresponding
    lens driver for the camera sensor module
    Set as y if the driver is used in this project

config MTK_LENS_GAF008AF_SUPPORT
  bool "GAF008AF Lens Driver"
  default n
  help
    GAF008AF Lens Driver
    This config is used to enable the corresponding
    lens driver for the camera sensor module
    Set as y if the driver is used in this project

config MTK_LENS_WV511AAF_SUPPORT
  bool "WV511AAF Lens Driver"
  default n
  help
    WV511AAF Lens Driver
    This config is used to enable the corresponding
    lens driver for the camera sensor module
    Set as y if the driver is used in this project

config MTK_LENS_MN34172AF_SUPPORT
  bool "MN34172AF Lens Driver"
  default n
  help
    MN34172AF Lens Driver
    This config is used to enable the corresponding
    lens driver for the camera sensor module
    Set as y if the driver is used in this project

config MTK_LENS_MN045AF_SUPPORT
  bool "MN045AF Lens Driver"
  default n
  help
    MN045AF Lens Driver
    This config is used to enable the corresponding
    lens driver for the camera sensor module
    Set as y if the driver is used in this project

config MTK_LENS_S5K3L2AF_SUPPORT
  bool "S5K3L2AF Lens Driver"
  default n
  help
    S5K3L2AF Lens Driver
    This config is used to enable the corresponding
    lens driver for the camera sensor module
    Set as y if the driver is used in this project
config MTK_LENS_SP5506AF_SUPPORT
  bool "SP5506AF Lens Driver"
  default n
  help
    SP5506AF Lens Driver
    This config is used to enable the corresponding
    lens driver for the camera sensor module
    Set as y if the driver is used in this project

config MTK_LENS_IMX237AF_SUPPORT
  bool "IMX237AF Lens Driver"
  default n
  help
    IMX237AF Lens Driver
    This config is used to enable the corresponding
    lens driver for the camera sensor module
    Set as y if the driver is used in this project

config MTK_LENS_IMX214AF_SUPPORT
  bool "IMX214AF Lens Driver"
  default n
  help
    IMX214AF Lens Driver
    This config is used to enable the corresponding
    lens driver for the camera sensor module
    Set as y if the driver is used in this project

config MTK_LENS_IMX219AF_SUPPORT
  bool "IMX219AF Lens Driver"
  default n
  help
    IMX219AF Lens Driver
    This config is used to enable the corresponding
    lens driver for the camera sensor module
    Set as y if the driver is used in this project

config MTK_LENS_SP8407AF_SUPPORT
  bool "SP8407AF Lens Driver"
  default n
  help
    SP8407AF Lens Driver
    This config is used to enable the corresponding
    lens driver for the camera sensor module
    Set as y if the driver is used in this project

config MTK_LENS_OV8858AF_SUPPORT
  bool "OV8858AF Lens Driver"
  default n
  help
    OV8858AF Lens Driver
    This config is used to enable the corresponding
    lens driver for the camera sensor module
    Set as y if the driver is used in this project

config MTK_LENS_HI545AF_SUPPORT
  bool "HI545AF Lens Driver"
  default n
  help
    HI545AF Lens Driver
    This config is used to enable the corresponding
    lens driver for the camera sensor module
    Set as y if the driver is used in this project

config MTK_LENS_IMX149AF_SUPPORT
  bool "IMX149AF Lens Driver"
  default n
  help
    IMX149AF Lens Driver
    This config is used to enable the corresponding
    lens driver for the camera sensor module
    Set as y if the driver is used in this project

config MTK_LENS_OV5693AF_SUPPORT
  bool "OV5693AF Lens Driver"
  default n
  help
    OV5693AF Lens Driver
    This config is used to enable the corresponding
    lens driver for the camera sensor module
    Set as y if the driver is used in this project

config MTK_LENS_S5K3L8AF_SUPPORT
  bool "S5K3L8AF Lens Driver"
  default n
  help
    S5K3L8AF Lens Driver
    This config is used to enable the corresponding
    lens driver for the camera sensor module
    Set as y if the driver is used in this project
```

## drivers/misc/mediatek/power/mt6735/Kconfig
```kconfig
config QUICK_CHARGER_5V2A_SUPPORT
  bool CONFIG_QUICK_CHARGER_5V2A_SUPPORT
  default n
  help
    CONFIG_QUICK_CHARGER_5V2A_SUPPORT
```

## drivers/misc/mediatek/smartpa/Kconfig
```kconfig
config MTK_NXP_TFA9890
    bool "MTK_NXP_TFA9890"
	help
      SMARTPA sensor driverto detect 
```
