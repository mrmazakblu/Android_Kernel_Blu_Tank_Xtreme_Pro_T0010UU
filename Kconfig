## Kconfig
```kconfig
#
# For a description of the syntax of this configuration file,
# see Documentation/kbuild/kconfig-language.txt.
#
mainmenu "Linux/$ARCH $KERNELVERSION Kernel Configuration"

config SRCARCH
	string
	option env="SRCARCH"

config DROI_PRO
	string "DROI_PRO"
	help
	  To choose kernel DROI project define

config DROI_PRO_CUSTOM
	string "DROI_PRO_CUSTOM"
	help
	  To choose kernel DROI project custom define

config DROI_PRO_CUSTOM_CHILD
	string "DROI_PRO_CUSTOM_CHILD"
	help
	  To choose kernel DROI project custom child define
source "arch/$SRCARCH/Kconfig"
```

## drivers/input/fingerprint/Kconfig
```kconfig
#
#Fingerprint
#
menu "Fingerprint support"
    depends on INPUT

config MTK_FINGERPRINT_SUPPORT
    bool "Mediatek Fingerprint"
    default n
    ---help---
    Fingerprint mtk driver enable/disable in the kernel.
    Say Y here if you want to use mediatek fingerprint driver,
    fingerprint driver will support fingerprint function

if MTK_FINGERPRINT_SUPPORT
config MTK_FINGERPRINT_SELECT
    string "sensor type"
    default "GF318M"


if MTK_FINGERPRINT_SELECT = "FPC1145"
config FPC_FINGERPRINT
    bool "FPC Fingerprint"
    default n
    ---help---
    FPC fingerprint FPC's 102x/104x device.
endif

if MTK_FINGERPRINT_SELECT = "GF318M"
config GOODIX_FINGERPRINT
    bool "Goodix Fingerprint"
    default n
    ---help---
    Goodix Fingerprint chip GF316M/GF318M/GF3118M/GF518M/GF5118M/GF516M/GF816M/GF3208/GF5216 TEE driver

config GOODIX_SENSOR_TYPE
    string "SENSOR_TYPE"
    default "GF318M"
    ---help---
    Must input sensor type, or default is GF316M GF318M GF3118M GF518M GF5118M GF516M GF816M GF3208 GF5216
endif

config MA083T_FINGERPRINT
    bool "MA083T Fingerprint"
    default n
    ---help---
    MA083T Fingerprint chip ma083t driver

config MA080T_FINGERPRINT
    bool "MA080T Fingerprint"
    default n
    ---help---
    MA080T Fingerprint chip ma080t driver

config FINGERPRINT_MA120N
    bool "ma120n Fingerprint"
    default n
    ---help---
    MA120N Fingerprint chip ma120n driver

config FINGERPRINT_MA120N_TEE
    bool "ma120n tee Fingerprint"
    default n
    ---help---
    MA120N TEE Fingerprint chip ma120n tee driver

config MTK_MA116N
        bool "MA116N for MediaTek package"
        default n

config MTK_SUNWAVECORP
    bool "SUNWAVE Fingerprint"
    default n
    ---help---
    SUNWAVE Fingerprint chip sunwave driver

config MTK_SUNWAVECORP_TEE
    bool "SUNWAVE TEE Fingerprint"
    default n
    ---help---
    SUNWAVE TEE Fingerprint chip sunwave tee driver

endif

config FINGERPRINT_GF3258
    bool "gf3258 Fingerprint"
    default n
    ---help---
    GF3258 Fingerprint chip gf3258 driver

config FINGERPRINT_MA096N
    bool "ma096n Fingerprint"
    default n
    ---help---
    MA096N Fingerprint chip ma096n driver

config MTK_MA118N_TEE
    bool "ma118n tee Fingerprint"
    default n
    ---help---
    MA118N TEE Fingerprint chip ma118n tee driver

config MA083T_TEE_FINGERPRINT
    bool "MA083T TEE Fingerprint"
    default n
    ---help---
    MA083T TEE Fingerprint chip ma083t tee driver
endmenu
```

## drivers/input/touchscreen/mediatek/ICN85XX/Kconfig
```kconfig
#
# Touchscreen driver configuration
#
if TOUCHSCREEN_MTK_ICN86XX


config ICN86XX_CONFIG
	string "ICN86XX for Mediatek config"


config GTP_CUSTOM_CFG
	bool "ICN86XX for Mediatek package"
	default n
	help
	  Say Y here if you have ICN86XX touch panel GTP_CUSTOM_CFG.

	  If unsure, say N.

	  To compile this dirver as a module, choose M here: the
	  module will be called.

config GTP_CHANGE_X2Y
	bool "ICN86XX for Mediatek package"
	default n
	help
	  Say Y here if you have ICN86XX touch panel GTP_CHANGE_X2Y.

	  If unsure, say N.

	  To compile this dirver as a module, choose M here: the
	  module will be called.

config GTP_WARP_X_ON
	bool "ICN86XX for Mediatek package"
	default n
	help
	  Say Y here if you have ICN86XX touch panel GTP_WARP_X_ON.

	  If unsure, say N.

	  To compile this dirver as a module, choose M here: the
	  module will be called.

config GTP_WARP_Y_ON
	bool "ICN86XX for Mediatek package"
	default n
	help
	  Say Y here if you have ICN86XX touch panel GTP_WARP_Y_ON.

	  If unsure, say N.

	  To compile this dirver as a module, choose M here: the
	  module will be called.

config GTP_GESTURE_WAKEUP
	bool "ICN86XX for Mediatek package"
	default n
	help
	  Say Y here if you have ICN86XX touch panel GTP_GESTURE_WAKEUP.

	  If unsure, say N.

	  To compile this dirver as a module, choose M here: the
	  module will be called.

config GTP_PROXIMITY
	bool "ICN86XX for Mediatek package"
	default n
	help
	  Say Y here if you have ICN86XX touch panel GTP_PROXIMITY.

	  If unsure, say N.

	  To compile this dirver as a module, choose M here: the
	  module will be called.

config GTP_WITH_STYLUS
	bool "ICN86XX for Mediatek package"
	default n
	help
	  Say Y here if you have ICN86XX touch panel GTP_WITH_STYLUS.

	  If unsure, say N.

	  To compile this dirver as a module, choose M here: the
	  module will be called.

config GTP_HAVE_STYLUS_KEY
	bool "ICN86XX for Mediatek package"
	default n
	help
	  Say Y here if you have ICN86XX touch panel GTP_HAVE_STYLUS_KEY.

	  If unsure, say N.

	  To compile this dirver as a module, choose M here: the
	  module will be called.

config GTP_AUTO_UPDATE
	bool "ICN86XX for Mediatek package"
	default n
	help
	  Say Y here if you have ICN86XX touch panel GTP_AUTO_UPDATE.

	  If unsure, say N.

	  To compile this dirver as a module, choose M here: the
	  module will be called.

config GTP_HEADER_FW_UPDATE
	bool "ICN86XX for Mediatek package"
	default n
	help
	  Say Y here if you have ICN86XX touch panel GTP_HEADER_FW_UPDATE.

	  If unsure, say N.

	  To compile this dirver as a module, choose M here: the
	  module will be called.

config GTP_AUTO_UPDATE_CFG
	bool "ICN86XX for Mediatek package"
	default n
	help
	  Say Y here if you have ICN86XX touch panel GTP_AUTO_UPDATE_CFG.

	  If unsure, say N.

	  To compile this dirver as a module, choose M here: the
	  module will be called.

config GTP_CREATE_WR_NODE
	bool "ICN86XX for Mediatek package"
	default n
	help
	  Say Y here if you have ICN86XX touch panel GTP_CREATE_WR_NODE.

	  If unsure, say N.

	  To compile this dirver as a module, choose M here: the
	  module will be called.

config GTP_ESD_PROTECT
	bool "ICN86XX for Mediatek package"
	default n
	help
	  Say Y here if you have ICN86XX touch panel GTP_ESD_PROTECT.

	  If unsure, say N.

	  To compile this dirver as a module, choose M here: the
	  module will be called.

config GTP_CHARGER_SWITCH
	bool "ICN86XX for Mediatek package"
	default n
	help
	  Say Y here if you have ICN86XX touch panel GTP_CHARGER_SWITCH.

	  If unsure, say N.

	  To compile this dirver as a module, choose M here: the
	  module will be called.

config GTP_DEBUG_ARRAY_ON
	bool "ICN86XX for Mediatek package"
	default n
	help
	  Say Y here if you have ICN86XX touch panel GTP_DEBUG_ARRAY_ON.

	  If unsure, say N.

	  To compile this dirver as a module, choose M here: the
	  module will be called.

config GTP_DEBUG_FUNC_ON
	bool "ICN86XX for Mediatek package"
	default n
	help
	  Say Y here if you have ICN86XX touch panel GTP_DEBUG_FUNC_ON.

	  If unsure, say N.

	  To compile this dirver as a module, choose M here: the
	  module will be called.

config GTP_POWER_CTRL_SLEEP
	bool "ICN86XX for Mediatek package"
	default n
	help
	  Say Y here if you have ICN86XX touch panel GTP_POWER_CTRL_SLEEP.

	  If unsure, say N.

	  To compile this dirver as a module, choose M here: the
	  module will be called.
endif
```

## drivers/misc/mediatek/accelerometer/mxc400x-new/Kconfig
```kconfig
config MTK_MXC400X_NEW
	bool "MXC400X_NEW for MediaTek package"
	default n
	help
	  It support different accelerometer sensor.
          If this option is set,
	  it will support
          MC3410 Accelerometer.
```

## drivers/misc/mediatek/alsps/droi_gesture/Kconfig
```kconfig
config DROI_GESTURE
	bool "DROI_GESTURE for MediaTek package"
	depends on TOUCHSCREEN_MTK
	depends on MTK_HWMON
	default n
	help
	It support different type sensor
	in this platform. droi virtual sensor 
	depends proximity or gesture sensor driver.
	
```

## drivers/misc/mediatek/hall/Kconfig
```kconfig
config CUSTOM_KERNEL_HALL
	bool "CUSTOM_KERNEL_HALL"
	help
	  HALL sensor driverto detect

# AH1883 sensor
config MTK_AH1883
	bool "AH1883 for MediaTek package"
	default n
```

## drivers/misc/mediatek/leds/Kconfig
```kconfig
config MTK_LEDS
	tristate "MediaTek LED Support"
	depends on LEDS_CLASS
	---help---
	  This selects the MediaTek(R) LEDs connected to MediaTek chips.
	  If you want to use MediaTek(R) LEDs support, say Y or M here.
	  If unsure, say N.
	  Mediatek LED module includes backlight, indicate LED, keypad LED, button LED etc.

config LIGHTNESS_MAPPING_VALUE
	int "LIGHTNESS_MAPPING_VALUE"
	default 255
 	---help---
	  Backlight brightness mapping value, from 0 to 255.

config BACKLIGHT_SUPPORT_LP8557
	bool "Support backlight lp8557 board"

config BACKLIGHT_SUPPORT_LM3697
	bool "LM3697(DW8832) Support"
	default n
 	---help---
	  charge pump driver for external backlight

config MTK_LED_RGB_LIGHT
	bool "MediaTek LED_RGB_LIGHT Support"
	default n

config MTK_LED_RGB_LIGHT_USE_ISINK
	bool "MediaTek LED_RGB_LIGHT isink control"
	depends on MTK_LED_RGB_LIGHT
	default n

config MTK_LED_RGB_LIGHT_SGM31324
	bool "MediaTek LED_RGB_LIGHT_SGM31324 Support"
	default n
```
